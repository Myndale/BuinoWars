const byte sprites[][8] PROGMEM = {
        {6, 6, 0x00, 0x00, 0x00, 0x00, 0x00, 0x00},
        {6, 6, 0x20, 0x50, 0x88, 0x00, 0x00, 0x00},
        {6, 6, 0x00, 0x00, 0x00, 0x00, 0x00, 0x00},
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        {6, 6, 0xc0, 0x08, 0xb4, 0x40, 0x10, 0x2c}
};

void drawSprite(int8_t x, int8_t y, const uint8_t sprite_num) {

  const uint8_t * bitmap = sprites[sprite_num] + 2;
  uint8_t i, j;
  uint8_t * screen_line = gb.display.getBuffer() + x;
  const int byteWidth = (SPRITE_SIZE + 7) >> 3;
  const uint8_t * bitmap_line = bitmap;

  uint8_t dsty = y;
  uint8_t mask = _BV(y & 7);
  for (j = 0; j < SPRITE_SIZE; j++, dsty++, bitmap_line+=byteWidth, mask = (mask & 0x80) ? 1 : (mask<<1))
  {
    int ofs = (dsty >> 3) * LCDWIDTH_NOROT;
    uint8_t dstx = x;
    const uint8_t * bitmap_src = bitmap_line;
    uint8_t * ptr = screen_line + ofs;    
    uint8_t pixels = pgm_read_byte(bitmap_src++);
    if (pixels & 0x80)
      ptr[0] |= mask;
    if (pixels & 0x40)
      ptr[1] |= mask;
    if (pixels & 0x20)
      ptr[2] |= mask;
    if (pixels & 0x10)
      ptr[3] |= mask;
    if (pixels & 0x08)
      ptr[4] |= mask;
    if (pixels & 0x04)
      ptr[5] |= mask;
  }
}

